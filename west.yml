## west.yml
```yaml
# Copyright (c) 2022 Dhruva Gole <goledhruva@gmail.com>
# SPDX-License-Identifier: Apache-2.0

# NOTE: This is created to be used for CI/CD workflow. So use it only
# if you are in the zephyrproject directory or else things may break.

manifest:
    self:
        path: modules/lib/ArduinoCore-zephyr

    remotes:
        - name: caninos
          url-base: https://github.com/anacforcelli
        - name: zephyrproject-rtos
          url-base: https://github.com/zephyrproject-rtos
        - name: arduino
          url-base: https://github.com/arduino
        - name: facchinm
          url-base: https://github.com/facchinm
        - name: pillo79
          url-base: https://github.com/pillo79

    projects:
        - name: zephyr
          remote: caninos
          revision: main
          import:
              name-allowlist:
                  - littlefs
                  - tinycrypt
                  - tf-psa-crypto
                  - mbedtls
                  - segger
                  - thrift
                  - mcuboot
                  - nanopb
                  - lvgl
                  - zcbor
                  - fatfs
                  - hal_nxp
                  - hal_nordic
                  - hal_stm32
                  - hal_infineon
                  - hal_renesas
                  - hal_rpi_pico
                  - cmsis_6

        - name: ArduinoCore-API
          path: modules/lib/ArduinoCore-API
          revision: master
          url: https://github.com/arduino/ArduinoCore-API
```
